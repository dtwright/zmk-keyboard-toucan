## config/west.yml
```yaml
manifest:
  defaults:
    revision: v0.3
  remotes:
    - name: zmkfirmware
      url-base: https://github.com/zmkfirmware
    - name: petejohanson
      url-base: https://github.com/petejohanson/
    - name: caksoylar
      url-base: https://github.com/caksoylar
    - name: halfdane
      url-base: https://github.com/halfdane
    - name: amgskobo
      url-base: https://github.com/amgskobo
    - name: oleksandrmaslov
      url-base: https://github.com/oleksandrmaslov
  projects:
    - name: zmk
      remote: zmkfirmware
      import: app/west.yml
    - name: zmk-input-gestures
      remote: oleksandrmaslov
      revision: main
    - name: zmk-input-processors
      remote: amgskobo
      revision: main
    - name: cirque-input-module
      remote: halfdane
      revision: absolute_mode
    #- name: cirque-input-module
    #  remote: petejohanson
    #  revision: main
    - name: zmk-rgbled-widget
      remote: caksoylar
      revision: main
  self:
    path: config
```
